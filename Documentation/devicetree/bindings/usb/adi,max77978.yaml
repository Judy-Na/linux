## Documentation/devicetree/bindings/usb/adi,max77978.yaml
```yaml
# SPDX-License-Identifier: (GPL-2.0-only OR BSD-2-Clause)
%YAML 1.2
---
$id: http://devicetree.org/schemas/usb/adi,max77978.yaml#
$schema: http://devicetree.org/meta-schemas/core.yaml#

title: Analog Devices MAX77978 USB Type-C and Power Delivery Controller

maintainers:
  - Sean Park <sean.park@analog.com>

description: |
  The MAX77978 is a USB Type-C port controller with Power Delivery support.
  It integrates BC1.2 charger detection and supports USB Type-C with Power
  Delivery for both sink and source roles.

properties:
  compatible:
    const: adi,max77978

  reg:
    maxItems: 1

  interrupts:
    maxItems: 1

  irq-gpios:
    maxItems: 1
    description:
      GPIO connected to the interrupt line of the MAX77978.

  wakeup-source: true

  connector:
    $ref: /schemas/connector/usb-connector.yaml#
    unevaluatedProperties: false

required:
  - compatible
  - reg

additionalProperties: false

examples:
  - |
    #include <dt-bindings/gpio/gpio.h>
    #include <dt-bindings/interrupt-controller/irq.h>

    i2c {
      #address-cells = <1>;
      #size-cells = <0>;

      max77978: usb-typec@25 {
        compatible = "adi,max77978";
        reg = <0x25>;
        irq-gpios = <&gpio 27 IRQ_TYPE_LEVEL_LOW>;
        wakeup-source;
      };
    };

...
```
